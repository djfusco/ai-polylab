## browser-linux-ai-lab/linux-build/configs/browser_ai_lab_defconfig
```kconfig
# Architecture
BR2_i386=y
BR2_x86_i686=y

# Toolchain
BR2_TOOLCHAIN_BUILDROOT_MUSL=y
BR2_TOOLCHAIN_BUILDROOT_CXX=n

# Kernel
BR2_LINUX_KERNEL=y
BR2_LINUX_KERNEL_LATEST_LTS_VERSION=y
BR2_LINUX_KERNEL_USE_DEFCONFIG=y
BR2_LINUX_KERNEL_DEFCONFIG="i386"
BR2_LINUX_KERNEL_BINARY_FORMAT=bzimage
BR2_LINUX_KERNEL_NEEDS_HOST_OPENSSL=y

# System
BR2_TARGET_GENERIC_HOSTNAME="ailab"
BR2_TARGET_GENERIC_ISSUE="Browser Linux AI Lab - Disposable Demo"
BR2_TARGET_GENERIC_ROOT_PASSWD=""
BR2_TARGET_ENABLE_ROOT_LOGIN=y
BR2_INIT_BUSYBOX=y
BR2_ENABLE_LOCALE=n
BR2_ENABLE_NLS=n

# Filesystem - initramfs (cpio.gz) for v86 direct boot
BR2_TARGET_ROOTFS_CPIO=y
BR2_TARGET_ROOTFS_CPIO_GZIP=y

# Overlay and post-build
BR2_ROOTFS_OVERLAY="board/browser-ai-lab/rootfs-overlay"
BR2_ROOTFS_POST_BUILD_SCRIPT="board/browser-ai-lab/post-build.sh"
BR2_ROOTFS_POST_IMAGE_SCRIPT="board/browser-ai-lab/post-image.sh"

# Packages
BR2_PACKAGE_BUSYBOX_SHOW_OTHERS=y
BR2_PACKAGE_BASH=y
BR2_PACKAGE_FILE=y
BR2_PACKAGE_XZ=y
BR2_PACKAGE_LESS=y
```
